#include <Arduino.h>
#include <Servo.h>
#include "USELESSBOX.h"

USELESSBOX::USELESSBOX(){
    sequence=0;
    buttonState=0;
}

void USELESSBOX::initialise(int pinSwitchServo, int pinLidServo, int _pinSwitch)
{        
    servoSchalter.attach(pinSwitchServo);
    servoDeckel.attach(pinLidServo);

    pinSwitch=_pinSwitch;
  	pinMode(pinSwitch,INPUT);

    //It is important for a sequence of values generated by random() to differ,
    //on subsequent executions of a sketch, use randomSeed() to initialize the random
    //number generator with a fairly random input, such as analogRead() on an 
    //unconnected pin. 
    randomSeed(analogRead(0));
}

void USELESSBOX::initLidServo(int open, int close)
{
    positionDeckelZu=close;
    positionDeckelAuf=open;
}

void USELESSBOX::initSwitchServo(int in, int out)
{
    positionArmAusgefahren=out;
    postionArmWeg=in;
}

void USELESSBOX::standby()
{
    servoSchalter.write(postionArmWeg);
    delay(70);
    servoDeckel.write(positionDeckelZu);
}

void USELESSBOX::run()
{
    buttonState=digitalRead(pinSwitch);

    if(buttonState==LOW) {
        
        sequence=random(5);

        switch (sequence) {
            case 0: initialDelay();
                    simpleMove();
                    break;
            case 1: initialDelay();
                    slowMove();
                    break;
            case 2: initialDelay();
                    zittern(5,15);
                    initialDelay();
                    simpleMove();
                    break;
            case 3: initialDelay();
                    fakeOpenLid();
                    break;
            case 4: initialDelay();
                    fakeSwitching();
                    break;
        }
    }
}

void USELESSBOX::initialDelay()
{
    delay(300);
}

void USELESSBOX::simpleMove()
{
    servoDeckel.write(positionDeckelAuf);
    delay(50);
    servoSchalter.write(positionArmAusgefahren);
    delay(300);
    servoSchalter.write(postionArmWeg);
    delay(70);
    servoDeckel.write(positionDeckelZu);
}

void USELESSBOX::slowMove()
{
    servoDeckel.write(positionDeckelAuf);
    delay(200);
    sweepArm("out",postionArmWeg,positionArmAusgefahren,servoSchalter);
    delay(200);
    sweepArm("in",positionArmAusgefahren,postionArmWeg,servoSchalter);
    delay(200);
    servoDeckel.write(positionDeckelZu);
}

void USELESSBOX::zittern(int repetitions, int lidHeight)
{
    int kuzesAuf=positionDeckelZu-lidHeight;

    do
    {
        servoDeckel.write(kuzesAuf);
        delay(50);
        servoDeckel.write(positionDeckelZu);
        delay(50);
        repetitions--;
    }while(repetitions>0);
}

void USELESSBOX::sweepArm(String direction, int startPosition, int endposition, Servo servoObject)
{
    if(direction=="out")
    {
        do
        {
            servoObject.write(startPosition);
            delay(15);
            startPosition++;
        }while(startPosition <=endposition);
    }
    else
    {
        do
        {
            servoObject.write(startPosition);
            delay(15);
            startPosition--;
        }while(startPosition >=endposition);
    }
}


void USELESSBOX::fakeOpenLid()
{
    servoDeckel.write(positionDeckelAuf+20);
    delay(600);
    servoDeckel.write(positionDeckelZu);
    delay(600);
    zittern(4,15);
    delay(1000);
    simpleMove();
}

void USELESSBOX::fakeSwitching()
{
    servoDeckel.write(positionDeckelAuf+20);
    delay(200);
    sweepArm("out",postionArmWeg,positionArmAusgefahren-10,servoSchalter);
    delay(800);
    sweepArm("in",positionArmAusgefahren-10,postionArmWeg,servoSchalter);
    delay(200);
    servoDeckel.write(positionDeckelZu);
    delay(1000);
    zittern(4,15);
    delay(1000);
    simpleMove();
}


USELESSBOX::~USELESSBOX(){}